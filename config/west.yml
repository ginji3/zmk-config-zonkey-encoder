## config/west.yml
```yaml
manifest:
  remotes:
    - name: zmkfirmware
      url-base: https://github.com/zmkfirmware
    - name: caksoylar                      # <-- caksoylar 氏のリモートを利用
      url-base: https://github.com/caksoylar  
  projects:
    - name: zmk
      remote: zmkfirmware
      revision: main
      import: app/west.yml
    - name: zmk-pmw3610-driver
      remote: caksoylar                    # <-- petejohanson から caksoylar に変更
      revision: main                       # <-- 最新のZephyr 4.1対応ブランチ
    - name: zmk-rgbled-widget
      remote: caksoylar
      revision: main
  self:
    path: config
```
